## tools/memory_monitor_drivers_suite/page_protection/Kconfig
```kconfig
#
# 真正的MMU硬件级内存保护监控驱动配置
#

config TRUE_MMU_MONITOR
	tristate "真正的MMU硬件级内存保护监控驱动"
	depends on MMU
	help
	  这是一个真正的MMU硬件级内存保护监控驱动。
	  
	  它通过直接操作页表项的权限位来实现真正的硬件级内存保护，
	  而不是简单的软件检测。当程序违规访问受保护的内存时，
	  CPU硬件会自动触发页错误异常。
	  
	  特性：
	  - 真正的MMU页表操作
	  - CPU硬件自动检测违规访问
	  - 支持ARM32/ARM64/x86/x64架构
	  - 精确的页错误异常处理
	  - 无法通过软件绕过的硬件级保护
	  
	  适用场景：
	  - 缓冲区溢出检测
	  - 内存访问违规监控
	  - 系统安全防护
	  - 内核开发调试
	  
	  编译选项：
	  - Y: 编译到内核中（推荐）
	  - M: 编译为可加载模块
	  - N: 不编译
	  
	  如果不确定，选择N。

config TRUE_MMU_MONITOR_DEBUG
	bool "启用MMU监控调试模式"
	depends on TRUE_MMU_MONITOR
	default n
	help
	  启用调试模式后，当检测到内存访问违规时，
	  驱动会临时解除保护让程序继续执行，
	  而不是触发异常终止程序。
	  
	  这对于开发和调试非常有用，但会降低安全性。
	  在生产环境中不建议启用。

config TRUE_MMU_MONITOR_STATS
	bool "启用详细的统计信息"
	depends on TRUE_MMU_MONITOR
	default y
	help
	  启用详细的页错误统计信息收集，
	  包括读/写违规次数、错误地址分布等。
	  
	  这对于分析内存访问模式很有用。
```
